/*  Copyright (c) 2018, The Linux Foundation. All rights reserved.
 *  Copyright (c) 2018, Ketut P. Kumajaya.
 *  Copyright (c) 2020, the_shahnawaz_sheikh (sheikhshahnawaz41299).
 *
 * This program is free software; you can redistribute it and/or modify
 * it under the terms of the GNU General Public License version 2 and
 * only version 2 as published by the Free Software Foundation.
 *
 * This program is distributed in the hope that it will be useful,
 * but WITHOUT ANY WARRANTY; without even the implied warranty of
 * MERCHANTABILITY or FITNESS FOR A PARTICULAR PURPOSE.  See the
 * GNU General Public License for more details.
 */

/dts-v1/;

#include "msm8916-mtp.dtsi"
#include "msm8916-memory.dtsi"
#include "pd1510/msm8916-mtp-pd1510.dtsi"

/ {
	model = "Qualcomm Technologies, Inc. MSM 8916 MTP - PD1510F_EX";
	compatible = "qcom,msm8916-mtp", "qcom,msm8916", "qcom,mtp";
	qcom,board-id = <8 22>;
};



