/* Copyright (c) 2013-2014, The Linux Foundation. All rights reserved.
 *
 * This program is free software; you can redistribute it and/or modify
 * it under the terms of the GNU General Public License version 2 and
 * only version 2 as published by the Free Software Foundation.
 *
 * This program is distributed in the hope that it will be useful,
 * but WITHOUT ANY WARRANTY; without even the implied warranty of
 * MERCHANTABILITY or FITNESS FOR A PARTICULAR PURPOSE.  See the
 * GNU General Public License for more details.
 */

&mdss_mdp {
	dsi_tmbklt_nt35596_1080_vid: qcom,mdss_dsi_tmbklt_nt35596_1080p_video {
		qcom,mdss-dsi-panel-name = "tmbklt_nt35596 1080p video mode dsi panel";
		qcom,mdss-dsi-panel-controller = <&mdss_dsi0>;
		qcom,mdss-dsi-panel-type = "dsi_video_mode";
		qcom,mdss-dsi-panel-destination = "display_1";
		qcom,mdss-dsi-panel-framerate = <60>;
		qcom,mdss-dsi-virtual-channel-id = <0>;
		qcom,mdss-dsi-stream = <0>;
		qcom,mdss-dsi-panel-id = <0x11>;
		qcom,mdss-dsi-panel-width = <1080>;
		qcom,mdss-dsi-panel-height = <1920>;
		qcom,mdss-dsi-h-front-porch = <60>;//30
		qcom,mdss-dsi-h-back-porch = <236>;//25
		qcom,mdss-dsi-h-pulse-width = <5>;//20
		qcom,mdss-dsi-h-sync-skew = <0>;
		qcom,mdss-dsi-v-back-porch = <8>;//6
		qcom,mdss-dsi-v-front-porch = <10>;////14
		qcom,mdss-dsi-v-pulse-width = <2>;
		qcom,mdss-dsi-h-left-border = <0>;
		qcom,mdss-dsi-h-right-border = <0>;
		qcom,mdss-dsi-v-top-border = <0>;
		qcom,mdss-dsi-v-bottom-border = <0>;
		qcom,mdss-dsi-bpp = <24>;
		qcom,mdss-dsi-underflow-color = <0xff>;
		qcom,mdss-dsi-border-color = <0>;
		qcom,mdss-dsi-on-command = [
		
			29 01 00 00 00 00 02 FF EE
			29 01 00 00 0A 00 02 18 40
			29 01 00 00 14 00 02 18 00
			29 01 00 00 00 00 02 FF 00
			29 01 00 00 00 00 02 FB 01
			29 01 00 00 00 00 02 35 01
			29 01 00 00 00 00 02 D3 0A
			29 01 00 00 00 00 02 D4 0A
			29 01 00 00 00 00 02 FF 01
			29 01 00 00 00 00 02 13 13
			29 01 00 00 00 00 02 FF 04
			29 01 00 00 00 00 02 FB 01
			29 01 00 00 00 00 02 08 04
			/*29 01 00 00 00 00 02 FF 01/////set VGH
			29 01 00 00 00 00 02 FB 01
			29 01 00 00 00 00 02 01 66
			29 01 00 00 00 00 02 02 50
			29 01 00 00 00 00 02 05 90
			29 01 00 00 00 00 02 06 14
			29 01 00 00 00 00 02 07 1E//*/			
			
			29 01 00 00 00 00 02 FF 01////add 0322 for dadianliu
			29 01 00 00 0A 00 02 FB 01
			29 01 00 00 14 00 02 06 4A
			29 01 00 00 00 00 02 15 93
			29 01 00 00 00 00 02 16 93	
			
			
			
			////////////////////////////////////////3gamma end
			//R(+) MCR cmd
			29 01 00 00 00 00 02 75 00
			29 01 00 00 0A 00 02 76 00
			29 01 00 00 14 00 02 77 00
			29 01 00 00 00 00 02 78 16
			29 01 00 00 00 00 02 79 00
			29 01 00 00 00 00 02 7A 3B
			29 01 00 00 00 00 02 7B 00
			29 01 00 00 00 00 02 7C 57
			29 01 00 00 00 00 02 7D 00
			29 01 00 00 00 00 02 7E 6F
			29 01 00 00 00 00 02 7F 00
			29 01 00 00 00 00 02 80 83
			29 01 00 00 00 00 02 81 00
			29 01 00 00 00 00 02 82 96
			29 01 00 00 00 00 02 83 00
			29 01 00 00 00 00 02 84 A7
			29 01 00 00 00 00 02 85 00
			29 01 00 00 00 00 02 86 B7
			29 01 00 00 00 00 02 87 00
			29 01 00 00 00 00 02 88 EA
			29 01 00 00 00 00 02 89 01
			29 01 00 00 0A 00 02 8A 13
			29 01 00 00 14 00 02 8B 01
			29 01 00 00 00 00 02 8C 52
			29 01 00 00 00 00 02 8D 01
			29 01 00 00 00 00 02 8E 85
			29 01 00 00 00 00 02 8F 01
			29 01 00 00 00 00 02 90 D4
			29 01 00 00 00 00 02 91 02
			29 01 00 00 00 00 02 92 12
			29 01 00 00 00 00 02 93 02
			29 01 00 00 00 00 02 94 14
			29 01 00 00 00 00 02 95 02
			29 01 00 00 00 00 02 96 4D
			29 01 00 00 00 00 02 97 02
			29 01 00 00 00 00 02 98 8A
			29 01 00 00 00 00 02 99 02
			29 01 00 00 00 00 02 9A B0
			29 01 00 00 00 00 02 9B 02
			29 01 00 00 00 00 02 9C E5
			29 01 00 00 0A 00 02 9D 03
			29 01 00 00 14 00 02 9E 0A
			29 01 00 00 00 00 02 9F 03
			29 01 00 00 00 00 02 A0 39
			29 01 00 00 00 00 02 A2 03
			29 01 00 00 00 00 02 A3 46
			29 01 00 00 00 00 02 A4 03
			29 01 00 00 00 00 02 A5 56
			29 01 00 00 00 00 02 A6 03
			29 01 00 00 00 00 02 A7 67
			29 01 00 00 00 00 02 A9 03
			29 01 00 00 00 00 02 AA 7B
			29 01 00 00 00 00 02 AB 03
			29 01 00 00 00 00 02 AC 90
			29 01 00 00 00 00 02 AD 03
			29 01 00 00 00 00 02 AE AA
			29 01 00 00 00 00 02 AF 03
			29 01 00 00 00 00 02 B0 CC
			29 01 00 00 00 00 02 B1 03
			29 01 00 00 0A 00 02 B2 FF
			
			
			29 01 00 00 14 00 02 B3 00//R(-) MCR cmd 
			29 01 00 00 00 00 02 B4 00
			29 01 00 00 00 00 02 B5 00
			29 01 00 00 00 00 02 B6 16
			29 01 00 00 00 00 02 B7 00
			29 01 00 00 00 00 02 B8 3B
			29 01 00 00 00 00 02 B9 00
			29 01 00 00 00 00 02 BA 57
			29 01 00 00 00 00 02 BB 00
			29 01 00 00 00 00 02 BC 6F
			29 01 00 00 00 00 02 BD 00
			29 01 00 00 00 00 02 BE 83
			29 01 00 00 00 00 02 BF 00
			29 01 00 00 00 00 02 C0 96
			29 01 00 00 00 00 02 C1 00
			29 01 00 00 00 00 02 C2 A7
			29 01 00 00 00 00 02 C3 00
			29 01 00 00 00 00 02 C4 B7
			29 01 00 00 00 00 02 C5 00
			29 01 00 00 0A 00 02 C6 EA
			29 01 00 00 14 00 02 C7 01
			29 01 00 00 00 00 02 C8 13
			29 01 00 00 00 00 02 C9 01
			29 01 00 00 00 00 02 CA 52
			29 01 00 00 00 00 02 CB 01
			29 01 00 00 00 00 02 CC 85
			29 01 00 00 00 00 02 CD 01
			29 01 00 00 00 00 02 CE D4
			29 01 00 00 00 00 02 CF 02
			29 01 00 00 00 00 02 D0 12
			29 01 00 00 00 00 02 D1 02
			29 01 00 00 00 00 02 D2 14
			29 01 00 00 00 00 02 D3 02
			29 01 00 00 00 00 02 D4 4D
			29 01 00 00 00 00 02 D5 02
			29 01 00 00 00 00 02 D6 8A
			29 01 00 00 00 00 02 D7 02
			29 01 00 00 00 00 02 D8 B0
			29 01 00 00 0A 00 02 D9 02
			29 01 00 00 14 00 02 DA E5
			29 01 00 00 00 00 02 DB 03
			29 01 00 00 00 00 02 DC 0A
			29 01 00 00 00 00 02 DD 03
			29 01 00 00 00 00 02 DE 39
			29 01 00 00 00 00 02 DF 03
			29 01 00 00 00 00 02 E0 46
			29 01 00 00 00 00 02 E1 03
			29 01 00 00 00 00 02 E2 56
			29 01 00 00 00 00 02 E3 03
			29 01 00 00 00 00 02 E4 67
			29 01 00 00 00 00 02 E5 03
			29 01 00 00 00 00 02 E6 7B
			29 01 00 00 00 00 02 E7 03
			29 01 00 00 00 00 02 E8 90
			29 01 00 00 00 00 02 E9 03
			29 01 00 00 00 00 02 EA AA
			29 01 00 00 00 00 02 EB 03
			29 01 00 00 0A 00 02 EC CC
			29 01 00 00 14 00 02 ED 03
			29 01 00 00 00 00 02 EE FF
			
			
			29 01 00 00 00 00 02 EF 00//G(+) MCR cmd
			29 01 00 00 00 00 02 F0 76
			29 01 00 00 00 00 02 F1 00
			29 01 00 00 00 00 02 F2 80
			29 01 00 00 00 00 02 F3 00
			29 01 00 00 00 00 02 F4 93//c0
			29 01 00 00 00 00 02 F5 00
			29 01 00 00 00 00 02 F6 A4//DA
			29 01 00 00 00 00 02 F7 00
			29 01 00 00 00 00 02 F8 B4//DD
			29 01 00 00 00 00 02 F9 00
			29 01 00 00 00 00 02 FA C8//E7
			
			29 01 00 00 00 00 02 FF 02//page selection cmd start 
			29 01 00 00 00 00 02 FB 01//page selection cmd end
			
			29 01 00 00 00 00 02 00 00 
			29 01 00 00 00 00 02 01 CF 
			29 01 00 00 00 00 02 02 00 
			29 01 00 00 0A 00 02 03 D9//FC 
			29 01 00 00 14 00 02 04 00 
			29 01 00 00 00 00 02 05 E4// 
			29 01 00 00 00 00 02 06 01 
			29 01 00 00 00 00 02 07 0F 
			29 01 00 00 00 00 02 08 01 
			29 01 00 00 00 00 02 09 32 
			29 01 00 00 00 00 02 0A 01 
			29 01 00 00 00 00 02 0B 67 
			29 01 00 00 00 00 02 0C 01 
			29 01 00 00 00 00 02 0D 94 
			29 01 00 00 00 00 02 0E 01 
			29 01 00 00 00 00 02 0F DF 
			29 01 00 00 00 00 02 10 02 
			29 01 00 00 00 00 02 11 1A 
			29 01 00 00 00 00 02 12 02 
			29 01 00 00 00 00 02 13 1D 
			29 01 00 00 00 00 02 14 02 
			29 01 00 00 00 00 02 15 52 
			29 01 00 00 0A 00 02 16 02 
			29 01 00 00 14 00 02 17 8F 
			29 01 00 00 00 00 02 18 02 
			29 01 00 00 00 00 02 19 B5 
			29 01 00 00 00 00 02 1A 02 
			29 01 00 00 00 00 02 1B E9 
			29 01 00 00 00 00 02 1C 03 
			29 01 00 00 00 00 02 1D 0C 
			29 01 00 00 00 00 02 1E 03 
			29 01 00 00 00 00 02 1F 3A 
			29 01 00 00 00 00 02 20 03 
			29 01 00 00 00 00 02 21 48 
			29 01 00 00 00 00 02 22 03 
			29 01 00 00 00 00 02 23 56 
			29 01 00 00 00 00 02 24 03 
			29 01 00 00 00 00 02 25 67 
			29 01 00 00 00 00 02 26 03 
			29 01 00 00 00 00 02 27 7B 
			29 01 00 00 00 00 02 28 03 
			29 01 00 00 0A 00 02 29 90 
			29 01 00 00 14 00 02 2A 03 
			29 01 00 00 00 00 02 2B AB 
			29 01 00 00 00 00 02 2D 03 
			29 01 00 00 00 00 02 2F D8 
			29 01 00 00 00 00 02 30 03 
			29 01 00 00 00 00 02 31 FF 
			
			
			29 01 00 00 00 00 02 32 00//G(-) MCR cmd
			29 01 00 00 00 00 02 33 76
			29 01 00 00 00 00 02 34 00
			29 01 00 00 00 00 02 35 80
			29 01 00 00 00 00 02 36 00
			29 01 00 00 00 00 02 37 93
			29 01 00 00 00 00 02 38 00
			29 01 00 00 00 00 02 39 A4
			29 01 00 00 00 00 02 3A 00
			29 01 00 00 00 00 02 3B B4
			29 01 00 00 00 00 02 3D 00
			29 01 00 00 00 00 02 3F C8
			29 01 00 00 00 00 02 40 00
			29 01 00 00 0A 00 02 41 CF
			29 01 00 00 14 00 02 42 00
			29 01 00 00 00 00 02 43 D9
			29 01 00 00 00 00 02 44 00
			29 01 00 00 00 00 02 45 E4
			29 01 00 00 00 00 02 46 01
			29 01 00 00 00 00 02 47 0F
			29 01 00 00 00 00 02 48 01
			29 01 00 00 00 00 02 49 32
			29 01 00 00 00 00 02 4A 01
			29 01 00 00 00 00 02 4B 67
			29 01 00 00 00 00 02 4C 01
			29 01 00 00 00 00 02 4D 94
			29 01 00 00 00 00 02 4E 01
			29 01 00 00 00 00 02 4F DF
			29 01 00 00 00 00 02 50 02
			29 01 00 00 00 00 02 51 1A
			29 01 00 00 00 00 02 52 02
			29 01 00 00 00 00 02 53 1D
			29 01 00 00 0A 00 02 54 02
			29 01 00 00 14 00 02 55 52
			29 01 00 00 00 00 02 56 02
			29 01 00 00 00 00 02 58 8F
			29 01 00 00 00 00 02 59 02
			29 01 00 00 00 00 02 5A B5
			29 01 00 00 00 00 02 5B 02
			29 01 00 00 00 00 02 5C E9
			29 01 00 00 00 00 02 5D 03
			29 01 00 00 00 00 02 5E 0C
			29 01 00 00 00 00 02 5F 03
			29 01 00 00 00 00 02 60 3A
			29 01 00 00 00 00 02 61 03
			29 01 00 00 00 00 02 62 48
			29 01 00 00 00 00 02 63 03
			29 01 00 00 00 00 02 64 56
			29 01 00 00 00 00 02 65 03
			29 01 00 00 00 00 02 66 67
			29 01 00 00 00 00 02 67 03
			29 01 00 00 0A 00 02 68 7B
			29 01 00 00 14 00 02 69 03
			29 01 00 00 00 00 02 6A 90
			29 01 00 00 00 00 02 6B 03
			29 01 00 00 00 00 02 6C AB
			29 01 00 00 00 00 02 6D 03
			29 01 00 00 00 00 02 6E D8
			29 01 00 00 00 00 02 6F 03
			29 01 00 00 00 00 02 70 FF
			
			
			29 01 00 00 00 00 02 71 00//B(+) MCR cmd
			29 01 00 00 00 00 02 72 04
			29 01 00 00 00 00 02 73 00
			29 01 00 00 00 00 02 74 18
			29 01 00 00 00 00 02 75 00
			29 01 00 00 00 00 02 76 38
			29 01 00 00 00 00 02 77 00
			29 01 00 00 00 00 02 78 50
			29 01 00 00 00 00 02 79 00
			29 01 00 00 00 00 02 7A 67
			29 01 00 00 00 00 02 7B 00
			29 01 00 00 0A 00 02 7C 82
			29 01 00 00 14 00 02 7D 00
			29 01 00 00 00 00 02 7E 8C
			29 01 00 00 00 00 02 7F 00
			29 01 00 00 00 00 02 80 9A
			29 01 00 00 00 00 02 81 00
			29 01 00 00 00 00 02 82 A9
			29 01 00 00 00 00 02 83 00
			29 01 00 00 00 00 02 84 DE
			29 01 00 00 00 00 02 85 01
			29 01 00 00 00 00 02 86 08
			29 01 00 00 00 00 02 87 01
			29 01 00 00 00 00 02 88 47
			29 01 00 00 00 00 02 89 01
			29 01 00 00 00 00 02 8A 7A
			29 01 00 00 00 00 02 8B 01
			29 01 00 00 00 00 02 8C CE
			29 01 00 00 00 00 02 8D 02
			29 01 00 00 00 00 02 8E 0E
			29 01 00 00 0A 00 02 8F 02
			29 01 00 00 14 00 02 90 11
			29 01 00 00 00 00 02 91 02
			29 01 00 00 00 00 02 92 4A
			29 01 00 00 00 00 02 93 02
			29 01 00 00 00 00 02 94 89
			29 01 00 00 00 00 02 95 02
			29 01 00 00 00 00 02 96 B0
			29 01 00 00 00 00 02 97 02
			29 01 00 00 00 00 02 98 E9
			29 01 00 00 00 00 02 99 03
			29 01 00 00 00 00 02 9A 13
			29 01 00 00 00 00 02 9B 03
			29 01 00 00 00 00 02 9C 60
			29 01 00 00 00 00 02 9D 03
			29 01 00 00 00 00 02 9E 71
			29 01 00 00 00 00 02 9F 03
			29 01 00 00 00 00 02 A0 74
			29 01 00 00 00 00 02 A2 03
			29 01 00 00 0A 00 02 A3 76
			29 01 00 00 14 00 02 A4 03
			29 01 00 00 00 00 02 A5 78
			29 01 00 00 00 00 02 A6 03
			29 01 00 00 00 00 02 A7 83
			29 01 00 00 00 00 02 A9 03
			29 01 00 00 00 00 02 AA 9C
			29 01 00 00 00 00 02 AB 03
			29 01 00 00 00 00 02 AC F3
			29 01 00 00 00 00 02 AD 03
			29 01 00 00 00 00 02 AE FF
			
			
			29 01 00 00 00 00 02 AF 00//B(-) MCR cmd
			29 01 00 00 00 00 02 B0 04
			29 01 00 00 00 00 02 B1 00
			29 01 00 00 00 00 02 B2 18
			29 01 00 00 00 00 02 B3 00
			29 01 00 00 00 00 02 B4 38
			29 01 00 00 00 00 02 B5 00
			29 01 00 00 00 00 02 B6 50
			29 01 00 00 00 00 02 B7 00
			29 01 00 00 0A 00 02 B8 67
			29 01 00 00 14 00 02 B9 00
			29 01 00 00 00 00 02 BA 82
			29 01 00 00 00 00 02 BB 00
			29 01 00 00 00 00 02 BC 8C
			29 01 00 00 00 00 02 BD 00
			29 01 00 00 00 00 02 BE 9A
			29 01 00 00 00 00 02 BF 00
			29 01 00 00 00 00 02 C0 A9
			29 01 00 00 00 00 02 C1 00
			29 01 00 00 00 00 02 C2 DE
			29 01 00 00 00 00 02 C3 01
			29 01 00 00 00 00 02 C4 08
			29 01 00 00 00 00 02 C5 01
			29 01 00 00 00 00 02 C6 47
			29 01 00 00 00 00 02 C7 01
			29 01 00 00 00 00 02 C8 7A
			29 01 00 00 00 00 02 C9 01
			29 01 00 00 00 00 02 CA CE
			29 01 00 00 0A 00 02 CB 02
			29 01 00 00 14 00 02 CC 0E
			29 01 00 00 00 00 02 CD 02
			29 01 00 00 00 00 02 CE 11
			29 01 00 00 00 00 02 CF 02
			29 01 00 00 00 00 02 D0 4A
			29 01 00 00 00 00 02 D1 02
			29 01 00 00 00 00 02 D2 89
			29 01 00 00 00 00 02 D3 02
			29 01 00 00 00 00 02 D4 B0
			29 01 00 00 00 00 02 D5 02
			29 01 00 00 00 00 02 D6 E9
			29 01 00 00 00 00 02 D7 03
			29 01 00 00 00 00 02 D8 13
			29 01 00 00 00 00 02 D9 03
			29 01 00 00 00 00 02 DA 60
			29 01 00 00 00 00 02 DB 03
			29 01 00 00 00 00 02 DC 71 
			29 01 00 00 00 00 02 DD 03
			29 01 00 00 00 00 02 DE 74
			29 01 00 00 0A 00 02 DF 03
			29 01 00 00 14 00 02 E0 76
			29 01 00 00 00 00 02 E1 03
			29 01 00 00 00 00 02 E2 78
			29 01 00 00 00 00 02 E3 03
			29 01 00 00 00 00 02 E4 83
			29 01 00 00 00 00 02 E5 03
			29 01 00 00 00 00 02 E6 9C
			29 01 00 00 00 00 02 E7 03
			29 01 00 00 00 00 02 E8 F3
			29 01 00 00 00 00 02 E9 03
			29 01 00 00 00 00 02 EA FF	
			
		
		
			////////////////////////////////////////3gamma end
			
			29 01 00 00 00 00 02 FF EE////AVDD detect
			29 01 00 00 00 00 02 FB 01
			29 01 00 00 00 00 02 25 00// 00 4.64V   01 4.47V   02   4.3V
			
			29 01 00 00 00 00 02 FF 00
			29 01 00 00 00 00 02 FB 01
			
			29 01 00 00 00 00 02 51 00
			29 01 00 00 00 00 02 53 24//2C
			29 01 00 00 00 00 02 55 01
			
			
			29 01 00 00 78 00 02 11 00
			29 01 00 00 14 00 02 29 00

];
		qcom,mdss-dsi-off-command = [05 01 00 00 32 00 02 28 00
					05 01 00 00 78 00 02 10 00];
		qcom,mdss-dsi-on-command-state = "dsi_lp_mode";
		qcom,mdss-dsi-off-command-state = "dsi_hs_mode";
		qcom,mdss-dsi-h-sync-pulse = <1>;
		qcom,mdss-dsi-traffic-mode = "burst_mode";
		qcom,mdss-dsi-lp11-init;
		qcom,mdss-dsi-init-delay-us = <10000>;
		qcom,mdss-dsi-bllp-eof-power-mode;
		qcom,mdss-dsi-bllp-power-mode;
		qcom,mdss-dsi-hbp-power-mode;////lrz add
		qcom,mdss-dsi-lane-0-state;
		qcom,mdss-dsi-lane-1-state;
		qcom,mdss-dsi-lane-2-state;
		qcom,mdss-dsi-lane-3-state;
		//qcom,mdss-dsi-panel-timings = [cf 32 20 00 5e 62 26 3A 2c 03 04 00];//f9 32 22 00 60 70 18 41 34 03 04 00
		qcom,mdss-dsi-panel-timings = [F8 3C 28 00 6e 72 2e 3E 35 03 04 00];
		qcom,mdss-dsi-t-clk-post = <0x02>;//1e
		qcom,mdss-dsi-t-clk-pre = <0x2D>;//38
		qcom,mdss-dsi-bl-min-level = <1>;
		qcom,mdss-dsi-bl-max-level = <255>;
		qcom,mdss-dsi-dma-trigger = "trigger_sw";
		qcom,mdss-dsi-mdp-trigger = "none";
		qcom,mdss-dsi-bl-pmic-control-type = "bl_ctrl_dcs";
		qcom,mdss-dsi-project-name = "pd1523a";
		qcom,mdss-pan-physical-width-dimension = <68>;
		qcom,mdss-pan-physical-height-dimension = <121>;
		qcom,mdss-dsi-reset-sequence = <1 5>, <0 5>, <1 5>,<0 5>, <1 20>;

	};
};
