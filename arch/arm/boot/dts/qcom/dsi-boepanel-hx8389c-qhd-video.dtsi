/* Copyright (c) 2013-2014, The Linux Foundation. All rights reserved.
 *
 * This program is free software; you can redistribute it and/or modify
 * it under the terms of the GNU General Public License version 2 and
 * only version 2 as published by the Free Software Foundation.
 *
 * This program is distributed in the hope that it will be useful,
 * but WITHOUT ANY WARRANTY; without even the implied warranty of
 * MERCHANTABILITY or FITNESS FOR A PARTICULAR PURPOSE.  See the
 * GNU General Public License for more details.
 */

&mdss_mdp {
	dsi_boehx8389c_qHD_vid: qcom,mdss_dsi_boehx8389c_qHD_video { 
		qcom,mdss-dsi-panel-name = "boehx8389c qHD video mode dsi panel";
		qcom,mdss-dsi-project-name = "pd1510";   
		qcom,mdss-dsi-panel-controller = <&mdss_dsi0>;
		qcom,mdss-dsi-panel-type = "dsi_video_mode";
		qcom,mdss-dsi-panel-destination = "display_1";
		qcom,mdss-dsi-panel-framerate = <60>;
		qcom,mdss-dsi-virtual-channel-id = <0>;
		qcom,mdss-dsi-stream = <0>;
		qcom,mdss-dsi-panel-id = <0x31>; 
		qcom,mdss-dsi-panel-width = <540>;
		qcom,mdss-dsi-panel-height = <960>;
		qcom,mdss-dsi-h-front-porch = <35>;
		qcom,mdss-dsi-h-back-porch = <90>;
		qcom,mdss-dsi-h-pulse-width = <8>;
		qcom,mdss-dsi-h-sync-skew = <0>;
		qcom,mdss-dsi-v-back-porch = <16>;
		qcom,mdss-dsi-v-front-porch = <14>;
		qcom,mdss-dsi-v-pulse-width = <2>;
		qcom,mdss-dsi-h-left-border = <0>;
		qcom,mdss-dsi-h-right-border = <0>;
		qcom,mdss-dsi-v-top-border = <0>;
		qcom,mdss-dsi-v-bottom-border = <0>;
		qcom,mdss-dsi-bpp = <24>;
		qcom,mdss-dsi-underflow-color = <0xff>;
		qcom,mdss-dsi-border-color = <0>;
		qcom,mdss-dsi-pixel-packing = "tight";
		qcom,mdss-dsi-on-command = [
		      39 01 00 00 00 00 04 B9 FF 83 89
					39 01 00 00 00 00 11 B1 7F 0A 0A 31 51 50 D0 EC 9C 80 20 20 F8 AA AA A3
					39 01 00 00 00 00 0B B2 80 50 05 03 50 38 11 64 55 09
					39 01 00 00 00 00 0C B4 77 5E 77 5E 77 5E 0E 72 0E 72 8E 
					39 01 00 00 00 00 24 D3 00 00 00 00 00 08 08 32 10 00 00 00 03 CA 03 CA 00 00 00 00 27 22 01 01 23 00 00 00 05 08 00 00 0A 00 01
					39 01 00 00 00 00 27 D5 18 18 18 18 18 18 01 00 03 02 19 19 19 19 21 20 18 18 18 18 18 18 18 18 18 18 18 18 18 18 18 18 18 18 18 18 18 18
					39 01 00 00 00 00 27 D6 18 18 18 18 18 18 02 03 00 01 19 19 18 18 20 21 19 19 18 18 18 18 18 18 18 18 18 18 18 18 18 18 18 18 18 18 18 18
					//29 01 00 00 00 00 2B E0 05 0A 0B 24 2D 3F 11 34 04 08 0B 17 0E 11 14 13 14 0B 12 17 18 05 0A 0B 24 2D 3F 11 34 04 08 0B 17 0E 11 14 13 14 0B 12 17 18
					39 01 00 00 00 00 2B E0 05 0A 0B 2C 35 3F 11 34 04 08 0B 17 0E 11 14 13 14 09 11 14 17 05 0A 0B 2C 35 3F 11 34 04 08 0B 17 0E 11 14 13 14 09 11 14 17
					39 01 00 00 00 00 03 B6 44 44
					39 01 00 00 00 00 02 BD 00
					39 01 00 00 00 00 2C c1 01 00 08 10 18 20 2A 31 39 41 49 51 59 61 68 6F 77 7E 85 8D 94 9C A4 AD B5 BC C4 CD D7 DE E6 EE F7 FF 15 B0 45 28 73 60 B4 47 C0  
					39 01 00 00 00 00 02 BD 01
					39 01 00 00 00 00 2B C1 00 08 0F 17 1F 2A 30 37 40 47 4F 57 5F 66 6D 74 7B 82 89 8F 97 9E A6 AE B5 BC C3 CB D4 DC E3 EA F2 0E 57 7A 15 03 60 AF 86 40
					39 01 00 00 00 00 02 BD 02
					39 01 00 00 00 00 2B C1 00 08 10 18 20 2B 31 3A 43 4B 53 5C 63 6B 72 7A 81 88 90 97 9F A7 B0 B7 BF C7 D0 D8 E0 E7 EE F7 FF 16 EF 4C D8 77 F7 13 2E C0
					39 01 00 00 00 00 02 BD 00
					39 01 00 00 00 00 02 D2 77 
					39 01 00 00 00 00 02 CC 02
					39 01 00 00 00 00 05 C7 00 80 60 C0
					05 01 00 00 78 00 02 11 00
					05 01 00 00 14 00 02 29 00
					];
		
		qcom,mdss-dsi-off-command = [
					05 01 00 00 14 00 02 28 00
					05 01 00 00 78 00 02 10 00
					];
		
		qcom,mdss-dsi-on-command-state = "dsi_lp_mode";
		qcom,mdss-dsi-off-command-state = "dsi_hs_mode";
		qcom,mdss-dsi-h-sync-pulse = <1>;
		qcom,mdss-dsi-traffic-mode = "burst_mode";
		qcom,mdss-dsi-bllp-eof-power-mode;
		qcom,mdss-dsi-bllp-power-mode;
		qcom,mdss-dsi-hbp-power-mode;
		qcom,mdss-dsi-lane-0-state;
		qcom,mdss-dsi-lane-1-state;
		qcom,mdss-dsi-panel-timings = [ 8B 1E 14 00 42 46 18 23 1B 03 04 00];//////////mipi timing
		qcom,mdss-dsi-t-clk-post = <0x04>;
		qcom,mdss-dsi-t-clk-pre = <0x1B>;
		qcom,mdss-dsi-lp11-init;
		qcom,mdss-dsi-init-delay-us = <10000>; 
		qcom,mdss-dsi-bl-min-level = <1>;
		qcom,mdss-dsi-bl-max-level = <255>;
		qcom,mdss-dsi-dma-trigger = "trigger_sw";
		qcom,mdss-dsi-mdp-trigger = "none";
		qcom,mdss-dsi-reset-sequence = <1 20>, <0 20>, <1 25>;
		qcom,mdss-pan-physical-width-dimension = <69>;
		qcom,mdss-pan-physical-height-dimension = <121>;
	};
};
