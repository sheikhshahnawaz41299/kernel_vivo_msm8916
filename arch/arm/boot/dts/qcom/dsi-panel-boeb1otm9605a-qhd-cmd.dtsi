/* Copyright (c) 2013  The Linux Foundation. All rights reserved.
 *
 * This program is free software; you can redistribute it and/or modify
 * it under the terms of the GNU General Public License version 2 and
 * only version 2 as published by the Free Software Foundation.
 *
 * This program is distributed in the hope that it will be useful 
 * but WITHOUT ANY WARRANTY; without even the implied warranty of
 * MERCHANTABILITY or FITNESS FOR A PARTICULAR PURPOSE.  See the
 * GNU General Public License for more details.
 */

/*---------------------------------------------------------------------------
 * This file is autogenerated file using gcdb parser. Please do not edit it.
 * Update input XML file to add a new entry or update variable in this file
 * VERSION = "1.0"
 *---------------------------------------------------------------------------*/
&mdss_mdp {
	dsi_boeb1otm9605a_qHD_vid: qcom,mdss_dsi_boeb1otm9605a_qhd_vid {
		qcom,mdss-dsi-panel-name = "boeb1otm9605a qHD video mode dsi panel";
		qcom,mdss-dsi-project-name = "pd1510";   
		qcom,mdss-dsi-panel-controller = <&mdss_dsi0>;
		qcom,mdss-dsi-panel-type = "dsi_video_mode";
		qcom,mdss-dsi-panel-destination = "display_1";
		qcom,mdss-dsi-panel-framerate = <60>;
		qcom,mdss-dsi-virtual-channel-id = <0>;
		qcom,mdss-dsi-stream = <0>;
		qcom,mdss-dsi-panel-id = <0x32>;
		qcom,mdss-dsi-panel-width = <540>;
		qcom,mdss-dsi-panel-height = <960>;
		qcom,mdss-dsi-h-front-porch = <15>;
		qcom,mdss-dsi-h-back-porch = <80>;
		qcom,mdss-dsi-h-pulse-width = <8>;
		qcom,mdss-dsi-h-sync-skew = <0>;
		qcom,mdss-dsi-v-back-porch = <16>;
		qcom,mdss-dsi-v-front-porch = <15>;
		qcom,mdss-dsi-v-pulse-width = <1>;
		qcom,mdss-dsi-h-left-border = <0>;
		qcom,mdss-dsi-h-right-border = <0>;
		qcom,mdss-dsi-v-top-border = <0>;
		qcom,mdss-dsi-v-bottom-border = <0>;
		qcom,mdss-dsi-bpp = <24>;
		qcom,mdss-dsi-underflow-color = <0xff>;
		qcom,mdss-dsi-border-color = <0>;
		
		qcom,mdss-dsi-on-command = [
					29 01 00 00 00 00 02 00 00 
                    29 01 00 00 00 00 04 FF 96  05  01    
                    29 01 00 00 00 00 02 00 80 
                    29 01 00 00 00 00 03 FF 96  05 
                   
                    29 01 00 00 00 00 02 00 B4 	
                    29 01 00 00 00 00 02 C0 50 
            
                    29 01 00 00 00 00 02 00 80 
                    29 01 00 00 00 00 03 C1 36  77  
                  
                    29 01 00 00 00 00 02 00 89 
                    29 01 00 00 00 00 02 C0 01 
                 
                    29 01 00 00 00 00 02 00 A0 
                    29 01 00 00 00 00 02 C1 00 
                 
                    29 01 00 00 00 00 02 00 00 
                    29 01 00 00 00 00 02 A0 00 
                
                    29 01 00 00 00 00 02 00 A2 
                    29 01 00 00 00 00 04 C0 01  10  00 //source EQ
               
                    29 01 00 00 00 00 02 00 91 
                    29 01 00 00 00 00 02 C5 77 
                 
                    29 01 00 00 00 00 02 00 80 
                    29 01 00 00 00 00 0B CB 00  00  00  00  00  00  00  00  00  00 
          
                    29 01 00 00 00 00 02 00 90 
                    29 01 00 00 00 00 10 CB 00  00  00  00  00  00  00  00  00  00  00  00  00  00  00 
                 
                    29 01 00 00 00 00 02 00 A0 
                    29 01 00 00 00 00 10 CB 00  00  00  00  00  00  00  00  00  00  00  00  00  00  00 
                  
                    29 01 00 00 00 00 02 00 B0 
                    29 01 00 00 00 00 0B CB 00  00  00  00  00  00  00  00  00  00 
                   
                    29 01 00 00 00 00 02 00 C0 
                    29 01 00 00 00 00 10 CB 00  00  04  04  04  04  04  00  00  00  00  00  00  00  00 
                    
                    29 01 00 00 00 00 02 00 D0 
                    29 01 00 00 00 00 10 CB 00  00  00  00  00  00  00  04  04  04  04  04  00  00  00 
               
                    29 01 00 00 00 00 02 00 E0 
                    29 01 00 00 00 00 0B CB 00  00  00  00  00  00  00  00  00  00 
                  
                    29 01 00 00 00 00 02 00 F0 
                    29 01 00 00 00 00 0B CB FF  FF  FF  FF  FF  FF  FF  FF  FF  FF 
                  
                    29 01 00 00 00 00 02 00 80 
                    29 01 00 00 00 00 0B CC 00  00  09  0B  01  25  26  00  00  00 
                  
                    29 01 00 00 00 00 02 00 90 
                    29 01 00 00 00 00 10 CC 00  00  00  00  00  00  00  00  00  00  00  00  0A  0C  02 
              
                    29 01 00 00 00 00 02 00 A0 
                    29 01 00 00 00 00 10 CC 25  26  00  00  00  00  00  00  00  00  00  00  00  00  00 
         
                    29 01 00 00 00 00 02 00 80 
                    29 01 00 00 00 00 0D CE 86  01  06  85  01  06  0F  00  00  0F  00  00 
             
                    29 01 00 00 00 00 02 00 90 
                    29 01 00 00 00 00 0F CE F0  00  00  F0  00  00  F0  00  00  F0  00  00  00  00 
        
                    29 01 00 00 00 00 02 00 A0 
                    29 01 00 00 00 00 0F CE 18  05  03  C0  00  06  00  18  04  03  C1  00  06  00 
               
                    29 01 00 00 00 00 02 00 B0 
                    29 01 00 00 00 00 0F CE 18  03  03  C2  00  06  00  18  02  03  C3  00  06  00 
         
                    29 01 00 00 00 00 02 00 C0 
                    29 01 00 00 00 00 0F CE F0  00  00  10  00  00  00  F0  00  00  10  00  00  00 
             
                    29 01 00 00 00 00 02 00 D0 
                    29 01 00 00 00 00 0F CE F0  00  00  10  00  00  00  F0  00  00  10  00  00  00 
         
                    29 01 00 00 00 00 02 00 80 
                    29 01 00 00 00 00 0F CF F0  00  00  10  00  00  00  F0  00  00  10  00  00  00 
         
                    29 01 00 00 00 00 02 00 90 
                    29 01 00 00 00 00 0F CF F0  00  00  10  00  00  00  F0  00  00  10  00  00  00 
 
                    29 01 00 00 00 00 02 00 A0 
                    29 01 00 00 00 00 0F CF F0  00  00  10  00  00  00  F0  00  00  10  00  00  00 
            
                    29 01 00 00 00 00 02 00 B0 
                    29 01 00 00 00 00 0F CF F0  00  00  10  00  00  00  F0  00  00  10  00  00  00 
      
                    29 01 00 00 00 00 02 00 C0 
                    29 01 00 00 00 00 0B CF 02  02  10  10  00  00  01  81  00  08 //GATE EQ
           
                    29 01 00 00 00 00 02 00 80 
                    29 01 00 00 00 00 02 D6 00
              
                    29 01 00 00 00 00 02 00 00
                    29 01 00 00 00 00 02 D7 00
           
                    29 01 00 00 00 00 02 00 00
                    29 01 00 00 00 00 03 D8 67 77
               
                    //29 01 00 00 00 00 02 00 00
                    //29 01 00 00 00 00 02 D9 23

                    29 01 00 00 00 00 02 00 80
                    29 01 00 00 00 00 02 C4 98 // source CURRENT
               
                    29 01 00 00 00 00 02 00 00 
                    29 01 00 00 00 00 11 E1 00 07 0C 0D 06 0F 0C 0B 02 06 0D 0A 11 15 0D 03
               
                    29 01 00 00 00 00 02 00 00 
                    29 01 00 00 00 00 11 E2 00 06 0B 0C 05 0F 0C 0B 02 06 0D 09 10 15 0D 03

					29 01 00 00 00 00 02 00 00
					29 01 00 00 00 00 22 EC 40 43 44 43 44 43 44 43 34 44 34 44 34 44 34 44 34 44 43 44 43 44 43 44 43 34 44 34 44 34 44 34 04

					29 01 00 00 00 00 02 00 00
					29 01 00 00 00 00 22 ED 40 44 34 44 44 44 44 43 44 44 44 34 44 44 44 44 34 44 44 44 44 43 44 44 44 34 44 44 44 44 43 44 04

					29 01 00 00 00 00 02 00 00
					29 01 00 00 00 00 22 EE 40 44 34 44 44 44 34 44 44 44 34 44 44 44 34 44 44 44 34 44 44 44 34 44 44 44 34 44 44 44 34 44 04

					05 01 00 00 78 00 02 11 00
					05 01 00 00 14 00 02 29 00	
					];
					
		qcom,mdss-dsi-off-command = [
				05 01 00 00 78 00 02 10 00
				05 01 00 00 32 00 02 28 00];
		qcom,mdss-dsi-on-command-state = "dsi_lp_mode";
		qcom,mdss-dsi-off-command-state = "dsi_hs_mode";
		qcom,mdss-dsi-h-sync-pulse = <1>;
		qcom,mdss-dsi-traffic-mode = "burst_mode";
		qcom,mdss-dsi-bllp-eof-power-mode;
		qcom,mdss-dsi-bllp-power-mode;
		qcom,mdss-dsi-lane-0-state;
		qcom,mdss-dsi-lane-1-state;
		//qcom,mdss-dsi-lane-2-state;
		//qcom,mdss-dsi-lane-3-state;
		//qcom,mdss-tear-check-frame-rate = <0x6000>;
		//qcom,mdss-dsi-hfp-power-mode;
		qcom,mdss-dsi-hbp-power-mode;
		//qcom,mdss-dsi-hsa-power-mode;
		qcom,mdss-dsi-lp11-init = <1>;
		qcom,mdss-dsi-init-delay-us = <50000>;
		qcom,mdss-dsi-panel-timings = [ 87 1C 12 00 42 44 18 20 17 03 04 00];//////////mipi timing
		qcom,mdss-dsi-t-clk-post = <0x04>;
		qcom,mdss-dsi-t-clk-pre = <0x1B>;
		qcom,mdss-dsi-bl-min-level = <1>;
		qcom,mdss-dsi-bl-max-level = <255>;
		qcom,mdss-dsi-dma-trigger = "trigger_sw";
		qcom,mdss-dsi-mdp-trigger = "none";
		qcom,mdss-dsi-bl-pmic-control-type = "bl_ctrl_wled";
		qcom,mdss-dsi-reset-sequence = <1 10>,<0 10>,<1 20>;/////reset
		qcom,mdss-pan-physical-width-dimension = <62>;
		qcom,mdss-pan-physical-height-dimension = <110>;

	};
};
