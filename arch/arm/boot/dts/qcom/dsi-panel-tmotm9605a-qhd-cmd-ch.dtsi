/* Copyright (c) 2013, The Linux Foundation. All rights reserved.
 *
 * This program is free software; you can redistribute it and/or modify
 * it under the terms of the GNU General Public License version 2 and
 * only version 2 as published by the Free Software Foundation.
 *
 * This program is distributed in the hope that it will be useful,
 * but WITHOUT ANY WARRANTY; without even the implied warranty of
 * MERCHANTABILITY or FITNESS FOR A PARTICULAR PURPOSE.  See the
 * GNU General Public License for more details.
 */

/*---------------------------------------------------------------------------
 * This file is autogenerated file using gcdb parser. Please do not edit it.
 * Update input XML file to add a new entry or update variable in this file
 * VERSION = "1.0"
 *---------------------------------------------------------------------------*/
&mdss_mdp {
	dsi_tmotm9605a_qHD_vid_ch: qcom,mdss_dsi_tmotm9605a_qhd_vid_ch {
		qcom,mdss-dsi-panel-name = "tmotm9605a qHD video mode dsi panel";
		qcom,mdss-dsi-project-name = "pd1510"; 
		qcom,mdss-dsi-panel-controller = <&mdss_dsi0>;
		qcom,mdss-dsi-panel-type = "dsi_video_mode";
		qcom,mdss-dsi-panel-destination = "display_1";
		qcom,mdss-dsi-panel-framerate = <60>;
		qcom,mdss-dsi-virtual-channel-id = <0>;
		qcom,mdss-dsi-stream = <0>;
		qcom,mdss-dsi-panel-id = <0x10>;
		qcom,mdss-dsi-panel-width = <540>;
		qcom,mdss-dsi-panel-height = <960>;
		qcom,mdss-dsi-h-front-porch = <35>;
		qcom,mdss-dsi-h-back-porch = <90>;
		qcom,mdss-dsi-h-pulse-width = <8>;
		qcom,mdss-dsi-h-sync-skew = <0>;
		qcom,mdss-dsi-v-back-porch = <16>;
		qcom,mdss-dsi-v-front-porch = <15>;
		qcom,mdss-dsi-v-pulse-width = <1>;
		qcom,mdss-dsi-h-left-border = <0>;
		qcom,mdss-dsi-h-right-border = <0>;
		qcom,mdss-dsi-v-top-border = <0>;
		qcom,mdss-dsi-v-bottom-border = <0>;
		qcom,mdss-dsi-bpp = <24>;
		qcom,mdss-dsi-underflow-color = <0xff>;
		qcom,mdss-dsi-border-color = <0>;
		qcom,mdss-dsi-on-command = [
					29 01 00 00 00 00 02 00 00                                          
					29 01 00 00 00 00 04 FF 96 05 01                                 
					29 01 00 00 00 00 02 00 80                                          
					29 01 00 00 00 00 03 FF 96 05                                       
					29 01 00 00 00 00 02 00 00 
					29 01 00 00 00 00 02 A0 00                                  
					29 01 00 00 00 00 02 00 B4                                          
					29 01 00 00 00 00 02 C0 50                                          
					29 01 00 00 00 00 02 00 80                                          
					29 01 00 00 00 00 03 C1 36 66                                       
					29 01 00 00 00 00 02 00 89                                          
					29 01 00 00 00 00 02 C0 01                                          
					29 01 00 00 00 00 02 00 80                                          				
					29 01 00 00 00 00 02 C4 98                                       
					29 01 00 00 00 00 02 00 A0                                          				
					29 01 00 00 00 00 02 C1 00                                          
					29 01 00 00 00 00 02 00 C0                                          								    
					29 01 00 00 00 00 02 C5 00                                          
					29 01 00 00 00 00 02 00 C5                                          
					29 01 00 00 00 00 02 B0 03                                          
					29 01 00 00 00 00 02 00 90                                          
					29 01 00 00 00 00 08 c5 96 16 01 79 55 55 34                        
					29 01 00 00 00 00 02 00 A0                                          
					29 01 00 00 00 00 08 C5 96 16 00 79 33 33 34                        
					29 01 00 00 00 00 02 00 00                                          
					29 01 00 00 00 00 03 D8 57 77                                       
					29 01 00 00 00 00 02 00 B0                                          
					29 01 00 00 00 00 04 C5 04 28 21                                       
					29 01 00 00 00 00 02 00 80                                          				    					   					    
					29 01 00 00 00 00 0B CB 05 00 00 00 00 05 00 00 00 00               
					29 01 00 00 00 00 02 00 90                                                  
					29 01 00 00 00 00 10 CB 55 55 00 00 00 00 00 00 00 00 00 00 00 00 00
					29 01 00 00 00 00 02 00 A0                                          
					29 01 00 00 00 00 10 CB 00 00 00 00 00 55 55 00 00 00 00 00 00 00 00
					29 01 00 00 00 00 02 00 B0                                          		
					29 01 00 00 00 00 0B CB 00 00 00 00 00 00 00 00 00 00               
					29 01 00 00 00 00 02 00 C0                                          
					29 01 00 00 00 00 10 CB 55 55 00 00 00 04 00 04 00 04 00 04 04 04 00
					29 01 00 00 00 00 02 00 D0                                          
					29 01 00 00 00 00 10 CB 04 00 00 00 00 55 55 00 00 00 04 00 04 00 04
					29 01 00 00 00 00 02 00 E0                                          
					29 01 00 00 00 00 0B CB 00 04 04 04 00 04 00 00 00 00               
					29 01 00 00 00 00 02 00 F0                                          
					29 01 00 00 00 00 0B CB 0F 00 CC 00 00 0F 00 CC C3 00               
					29 01 00 00 00 00 02 00 80                                          
					29 01 00 00 00 00 0B CC 25 26 00 00 00 0C 00 0A 00 10               
					29 01 00 00 00 00 02 00 90                                          
					29 01 00 00 00 00 10 CC 00 0E 02 04 00 06 00 00 00 00 25 26 00 00 00
					29 01 00 00 00 00 02 00 A0                                          
					29 01 00 00 00 00 10 CC 0B 00 09 00 0F 00 0D 01 03 00 05 00 00 00 00
					29 01 00 00 00 00 02 00 B0                                              
					29 01 00 00 00 00 0B CC 26 25 00 00 00 0D 00 0F 00 09                   
					29 01 00 00 00 00 02 00 C0                                              
					29 01 00 00 00 00 10 CC 00 0B 03 01 00 05 00 00 00 00 26 25 00 00 00    
					29 01 00 00 00 00 02 00 D0                                              
					29 01 00 00 00 00 10 CC 0E 00 10 00 0A 00 0C 04 02 00 06 00 00 00 00    
					29 01 00 00 00 00 02 00 80                                              
					29 01 00 00 00 00 0D CE 8B 03 38 8A 03 38 89 03 38 88 03 38             
					29 01 00 00 00 00 02 00 90                                              
					29 01 00 00 00 00 0F CE 38 10 38 38 0f 38 00 00 00 00 00 00 00 00      
					29 01 00 00 00 00 02 00 A0                                              
					29 01 00 00 00 00 0F CE 38 07 03 C0 00 38 00 38 06 03 C1 00 38 00       
					29 01 00 00 00 00 02 00 B0                                              
					29 01 00 00 00 00 0F CE 38 05 03 C2 00 38 00 38 04 03 C3 00 38 00       
					29 01 00 00 00 00 02 00 C0                                              
					29 01 00 00 00 00 0F CE 38 03 03 C4 00 38 00 38 02 03 C5 00 38 00       
					29 01 00 00 00 00 02 00 D0                                              
					29 01 00 00 00 00 0F CE 38 01 03 C6 00 38 00 38 00 03 C7 00 38 00       
					29 01 00 00 00 00 02 00 80                                              
					29 01 00 00 00 00 0F CF F0 00 00 10 00 00 00 F0 00 00 10 00 00 00       
					29 01 00 00 00 00 02 00 90                                              
					29 01 00 00 00 00 0F CF F0 00 00 10 00 00 00 F0 00 00 10 00 00 00       
					29 01 00 00 00 00 02 00 A0                                              
					29 01 00 00 00 00 0F CF F0 00 00 10 00 00 00 F0 00 00 10 00 00 00       
					29 01 00 00 00 00 02 00 B0                                              
					29 01 00 00 00 00 0F CF F0 00 00 10 00 00 00 F0 00 00 10 00 00 00       
					29 01 00 00 00 00 02 00 C0                                              
					29 01 00 00 00 00 0B CF 01 01 20 20 00 00 02 81 00 1A                   
					29 01 00 00 00 00 02 00 00                                               
					29 01 00 00 00 00 11 E1 0f 19 1e 0e 07 10 0B 0A 03 07 0b 08 0e 0f 0a 04
					29 01 00 00 00 00 02 00 00                                              
					29 01 00 00 00 00 11 E2 0C 15 1A 0E 07 11 0B 0A 04 07 0B 08 0e 0f 0a 04  
					29 01 00 00 00 00 02 00 00
					29 01 00 00 00 00 22 EC 40 44 44 44 44 44 44 44 44 44 44 44 44 44 44 44 44 44 44 44 44 44 44 44 44 44 44 44 44 44 44 44 04
					29 01 00 00 00 00 02 00 00
					29 01 00 00 00 00 22 ED 40 44 43 44 44 34 44 44 44 43 44 44 34 44 44 44 34 44 44 44 43 44 44 34 44 44 44 43 44 44 34 44 04
					29 01 00 00 00 00 02 00 00	
					29 01 00 00 00 00 22 EE 40 44 44 34 44 44 44 44 44 44 43 44 44 44 44 44 34 44 44 44 44 44 34 44 44 44 44 44 44 43 44 44 04 
					29 01 00 00 00 00 02 00 B2
					29 01 00 00 00 00 05 F5 15 00 15 00
					29 01 00 00 00 00 02 00 A2
					29 01 00 00 00 00 04 C0 20 18 09
					05 01 00 00 78 00 02 11 00
					05 01 00 00 14 00 02 29 00
					];						
		qcom,mdss-dsi-off-command = [
		        29 01 00 00 00 00 02 00 90                                          
				29 01 00 00 00 00 08 c5 96 00 06 79 55 55 34                        
				29 01 00 00 00 00 02 00 A0                                          
				29 01 00 00 00 00 08 C5 96 00 06 79 33 33 34
				05 01 00 00 78 00 02 10 00
				05 01 00 00 32 00 02 28 00];
		qcom,mdss-dsi-on-command-state = "dsi_lp_mode";
		qcom,mdss-dsi-off-command-state = "dsi_hs_mode";
		qcom,mdss-dsi-h-sync-pulse = <1>;
		qcom,mdss-dsi-traffic-mode = "burst_mode";
		qcom,mdss-dsi-bllp-eof-power-mode;
		qcom,mdss-dsi-bllp-power-mode;
		qcom,mdss-dsi-lane-0-state;
		qcom,mdss-dsi-lane-1-state;
		//qcom,mdss-dsi-lane-2-state;
		//qcom,mdss-dsi-lane-3-state;
		//qcom,mdss-tear-check-frame-rate = <0x6000>;///// (fps X100), please check fps at your end
		//qcom,mdss-dsi-hfp-power-mode;
		qcom,mdss-dsi-hbp-power-mode;
		//qcom,mdss-dsi-hsa-power-mode;
		qcom,mdss-dsi-lp11-init = <1>;
		qcom,mdss-dsi-init-delay-us = <50000>;
		qcom,mdss-dsi-panel-timings = [ 8B 1E 14 00 42 46 18 23 1B 03 04 00];//////////mipi timing
		qcom,mdss-dsi-t-clk-post = <0x04>;
		qcom,mdss-dsi-t-clk-pre = <0x1B>;
		qcom,mdss-dsi-bl-min-level = <1>;
		qcom,mdss-dsi-bl-max-level = <255>;
		qcom,mdss-dsi-dma-trigger = "trigger_sw";
		qcom,mdss-dsi-mdp-trigger = "none";
		qcom,mdss-dsi-bl-pmic-control-type = "bl_ctrl_wled";
		qcom,mdss-dsi-reset-sequence = <1 10>, <0 10>, <1 20>;/////reset
		qcom,mdss-pan-physical-width-dimension = <62>;
		qcom,mdss-pan-physical-height-dimension = <110>;
		qcom,mdss-dsi-panel-status-command = [06 01 00 01 05 00 02 0A 08];
		qcom,mdss-dsi-panel-status-command-state = "dsi_lp_mode";
		qcom,mdss-dsi-panel-status-check-mode = "reg_read";
		qcom,mdss-dsi-panel-status-value = <0x9c>;

	};
};
