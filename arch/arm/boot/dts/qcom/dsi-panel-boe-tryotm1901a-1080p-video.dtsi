/* Copyright (c) 2013-2014, The Linux Foundation. All rights reserved.
 *
 * This program is free software; you can redistribute it and/or modify
 * it under the terms of the GNU General Public License version 2 and
 * only version 2 as published by the Free Software Foundation.
 *
 * This program is distributed in the hope that it will be useful,
 * but WITHOUT ANY WARRANTY; without even the implied warranty of
 * MERCHANTABILITY or FITNESS FOR A PARTICULAR PURPOSE.  See the
 * GNU General Public License for more details.
 */

&mdss_mdp {
	dsi_boe_tryotm1901a_1080p_vid: qcom,mdss_dsi_boe_tryotm1901a_1080p_video {
		qcom,mdss-dsi-panel-name = "boe tryotm1901a 1080p video mode dsi panel";
		qcom,mdss-dsi-panel-controller = <&mdss_dsi0>;
		qcom,mdss-dsi-panel-type = "dsi_video_mode";
		qcom,mdss-dsi-panel-destination = "display_1";
		qcom,mdss-dsi-panel-framerate = <60>;
		qcom,mdss-dsi-virtual-channel-id = <0>;
		qcom,mdss-dsi-stream = <0>;
		qcom,mdss-dsi-panel-id = <0x02>; 
		qcom,mdss-dsi-panel-width = <1080>;
		qcom,mdss-dsi-panel-height = <1920>;
		qcom,mdss-dsi-h-front-porch = <93>;//should be large than 32
		qcom,mdss-dsi-h-back-porch = <93>;//25
		qcom,mdss-dsi-h-pulse-width = <5>;//20
		qcom,mdss-dsi-h-sync-skew = <0>;
		qcom,mdss-dsi-v-back-porch = <8>;//6
		qcom,mdss-dsi-v-front-porch = <10>;////14
		qcom,mdss-dsi-v-pulse-width = <2>;		
		qcom,mdss-dsi-h-left-border = <0>;
		qcom,mdss-dsi-h-right-border = <0>;
		qcom,mdss-dsi-v-top-border = <0>;
		qcom,mdss-dsi-v-bottom-border = <0>;
		qcom,mdss-dsi-bpp = <24>;
		qcom,mdss-dsi-underflow-color = <0xff>;
		qcom,mdss-dsi-border-color = <0>;
		
		qcom,mdss-dsi-on-command = [
			39 01 00 00 00 00 02 00 00 
			39 01 00 00 00 00 04 FF 19 01 01
			39 01 00 00 00 00 02 00 80 
			39 01 00 00 00 00 03 FF 19 01
			39 01 00 00 00 00 02 00 00 
			39 01 00 00 00 00 02 1C 33
			39 01 00 00 00 00 02 00 A0
			39 01 00 00 00 00 02 C1 E8
			39 01 00 00 00 00 02 00 A7
			39 01 00 00 00 00 02 C1 00
			39 01 00 00 00 00 02 00 90
			39 01 00 00 00 00 07 C0 00 2F 00 00 00 01
			39 01 00 00 00 00 02 00 C0
			39 01 00 00 00 00 07 C0 00 2F 00 00 00 01
			39 01 00 00 00 00 02 00 9A
			39 01 00 00 00 00 02 C0 1E
			39 01 00 00 00 00 02 00 AC
			39 01 00 00 00 00 02 C0 06
			39 01 00 00 00 00 02 00 DC
			39 01 00 00 00 00 02 C0 06
			39 01 00 00 00 00 02 00 81
			39 01 00 00 00 00 02 A5 04
			39 01 00 00 00 00 02 00 84
			39 01 00 00 00 00 02 C4 20
			39 01 00 00 00 00 02 00 A5
			39 01 00 00 00 00 02 B3 1d
			39 01 00 00 00 00 02 00 92
			39 01 00 00 00 00 02 E9 00
			39 01 00 00 00 00 02 00 90
			39 01 00 00 00 00 02 F3 01
			39 01 00 00 00 00 02 00 B4
			39 01 00 00 00 00 02 C0 80 
			39 01 00 00 00 00 02 00 93 
			39 01 00 00 00 00 02 C5 19 
			39 01 00 00 00 00 02 00 95 
			39 01 00 00 00 00 02 C5 2D 
			39 01 00 00 00 00 02 00 97 
			39 01 00 00 00 00 02 C5 14 
			39 01 00 00 00 00 02 00 99 
			39 01 00 00 00 00 02 C5 29 
			39 01 00 00 00 00 02 00 00 
			39 01 00 00 00 00 03 D8 1D 1D
			39 01 00 00 00 00 02 00 B3 
			39 01 00 00 00 00 02 C0 CC 
			39 01 00 00 00 00 02 00 BC 
			39 01 00 00 00 00 02 C0 00 
			39 01 00 00 00 00 02 00 F7 
			39 01 00 00 00 00 05 C3 04 18 04 04
			39 01 00 00 00 00 02 00 81 
			39 01 00 00 00 00 02 A5 07 
			39 01 00 00 00 00 02 00 9D 
			39 01 00 00 00 00 02 C5 88 
			39 01 00 00 00 00 02 00 9B
			39 01 00 00 00 00 03 C5 55 50
			39 01 00 00 00 00 02 00 80
			39 01 00 00 00 00 02 C4 15
			39 01 00 00 00 00 02 00 80
			39 01 00 00 00 00 0F C0 00 87 00 0A 0A 00 87 0A 0A 00 87 00 0A 0A
			39 01 00 00 00 00 02 00 F0
			39 01 00 00 00 00 07 C3 22 02 00 00 00 0C 
			39 01 00 00 00 00 02 00 A0
			39 01 00 00 00 00 08 C0 00 00 00 00 03 22 03 
			39 01 00 00 00 00 02 00 D0
			39 01 00 00 00 00 08 C0 00 00 00 00 03 22 03
			39 01 00 00 00 00 02 00 90
			39 01 00 00 00 00 09 C2 83 01 00 00 82 01 00 00
			39 01 00 00 00 00 02 00 80
			39 01 00 00 00 00 0D C3 82 02 03 00 03 84 81 03 03 00 03 84
			39 01 00 00 00 00 02 00 90
			39 01 00 00 00 00 0D C3 00 01 03 00 03 84 01 02 03 00 03 84
			39 01 00 00 00 00 02 00 80
			39 01 00 00 00 00 10 CC 09 0A 11 12 13 14 15 16 17 18 28 28 28 28 28 
			39 01 00 00 00 00 02 00 90
			39 01 00 00 00 00 10 CC 0A 09 14 13 12 11 15 16 17 18 28 28 28 28 28
			39 01 00 00 00 00 02 00 A0
			39 01 00 00 00 00 10 CC 1D 1E 1F 19 1A 1B 1C 20 21 22 23 24 25 26 27 
			39 01 00 00 00 00 02 00 B0
			39 01 00 00 00 00 09 CC 01 02 03 05 06 07 04 08 
			39 01 00 00 00 00 02 00 C0 
			39 01 00 00 00 00 0D CC 00 00 00 00 00 00 00 00 00 00 00 77 
			39 01 00 00 00 00 02 00 D0
			39 01 00 00 00 00 0D CC 00 00 00 00 05 00 00 00 00 00 00 77
			39 01 00 00 00 00 02 00 80
			39 01 00 00 00 00 10 CB 00 00 00 00 00 00 00 00 00 00 00 00 00 00 00 
			39 01 00 00 00 00 02 00 90
			39 01 00 00 00 00 10 CB 00 00 00 00 00 00 00 00 00 00 00 00 00 00 00
			39 01 00 00 00 00 02 00 A0
			39 01 00 00 00 00 10 CB 01 01 01 01 01 01 00 00 00 00 00 00 00 00 00
			39 01 00 00 00 00 02 00 B0 
			39 01 00 00 00 00 10 CB 00 01 FD 00 00 00 00 00 00 00 00 00 00 00 00
			39 01 00 00 00 00 02 00 C0
			39 01 00 00 00 00 09 CB 00 00 00 00 00 00 77 77
			39 01 00 00 00 00 02 00 D0
			39 01 00 00 00 00 09 CB 00 00 00 00 00 00 77 77
			39 01 00 00 00 00 02 00 E0
			39 01 00 00 00 00 09 CB 00 00 00 00 00 00 77 77
			39 01 00 00 00 00 02 00 F0
			39 01 00 00 00 00 09 CB 01 01 01 00 00 00 77 77
			39 01 00 00 00 00 02 00 80
			39 01 00 00 00 00 10 CD 3F 3F 3F 3F 3F 3F 3F 3F 3F 02 12 11 3F 04 3F 
			39 01 00 00 00 00 02 00 90
			39 01 00 00 00 00 0C CD 06 3F 3F 26 26 26 21 20 1F 26 26
			39 01 00 00 00 00 02 00 A0
			39 01 00 00 00 00 10 CD 3F 3F 3F 3F 3F 3F 3F 3F 3F 01 12 11 3F 03 3F
			39 01 00 00 00 00 02 00 B0
			39 01 00 00 00 00 0C CD 05 3F 3F 26 26 26 21 20 1F 26 26
			39 01 00 00 00 00 02 00 A0
			39 01 00 00 00 00 0D D6 01 01 ff fe fc fd ff fe fb ff 00 01
			39 01 00 00 00 00 02 00 B0
			39 01 00 00 00 00 0D D6 1e 27 21 15 17 00 00 22 0e 00 00 1f
			39 01 00 00 00 00 02 00 C0
			39 01 00 00 00 00 0D D6 0c 10 08 09 00 00 01 00 00 00 00 04
			39 01 00 00 00 00 02 00 D0
			39 01 00 00 00 00 0D D6 11 03 00 00 00 00 00 00 00 00 00 00
			39 01 00 00 00 00 02 00 00
			39 01 00 00 00 00 02 81 80

			39 01 00 00 00 00 02 00 F2
			39 01 00 00 00 00 04 C1 80 08 08

			39 01 00 00 00 00 02 00 00
			39 01 00 00 00 00 04 FF FF FF FF
                   
			39 01 00 00 00 00 02 51 FF               
			39 01 00 00 00 00 02 53 24
			39 01 00 00 00 00 02 55 00
                   
			39 01 00 00 78 00 02 11 00
			39 01 00 00 00 00 02 29 00
			
			39 01 00 00 32 00 02 22 00
			39 01 00 00 00 00 02 13 00

			39 01 00 00 00 00 02 00 00///lock CMD1
			39 01 00 00 00 00 03 99 00 00

		];
		qcom,mdss-dsi-off-command = [		
		39 01 00 00 00 00 02 00 00
		39 01 00 00 00 00 03 99 95 27///unlock CMD1
		05 01 00 00 14 00 02 28 00
		05 01 00 00 78 00 02 10 00
		39 01 00 00 00 00 02 00 00
		39 01 00 00 00 00 03 99 00 00
		];
		qcom,mdss-dsi-on-command-state = "dsi_lp_mode";
		qcom,mdss-dsi-off-command-state = "dsi_hs_mode";
		qcom,mdss-dsi-h-sync-pulse = <1>;
		qcom,mdss-dsi-traffic-mode = "burst_mode";
		qcom,mdss-dsi-lp11-init;
		qcom,mdss-dsi-init-delay-us = <10000>;////lrz add 0408
		qcom,mdss-dsi-bllp-eof-power-mode;
		qcom,mdss-dsi-bllp-power-mode;
		//qcom,mdss-dsi-hbp-power-mode;////lrz add 
		qcom,mdss-dsi-lane-0-state;
		qcom,mdss-dsi-lane-1-state;
		qcom,mdss-dsi-lane-2-state;
		qcom,mdss-dsi-lane-3-state;
		//qcom,mdss-dsi-panel-timings = [f9 32 22 00 60 70 18 41 34 03 04 00];
		qcom,mdss-dsi-panel-timings = [f9 38 26 00 68 6C 2A 3E 35 03 04 00];
		qcom,mdss-dsi-t-clk-post = <0x02>;
		qcom,mdss-dsi-t-clk-pre = <0x27>;
		qcom,mdss-dsi-bl-min-level = <1>;
		qcom,mdss-dsi-bl-max-level = <255>;
		qcom,mdss-dsi-dma-trigger = "trigger_sw";
		qcom,mdss-dsi-mdp-trigger = "none";
		qcom,mdss-dsi-bl-pmic-control-type = "bl_ctrl_dcs";
		qcom,mdss-dsi-project-name = "pd1523a";
		qcom,mdss-pan-physical-width-dimension = <68>;
		qcom,mdss-pan-physical-height-dimension = <121>;
		qcom,mdss-dsi-reset-sequence = <1 5>, <0 5>, <1 5>,<0 5>, <1 20>;
		qcom,esd-check-enabled;
		qcom,mdss-dsi-panel-status-command = [06 01 00 01 05 00 02 AC 08];
		qcom,mdss-dsi-panel-status-command-state = "dsi_hs_mode";
		qcom,mdss-dsi-panel-status-check-mode = "reg_read";
		qcom,mdss-dsi-panel-status-value = <0x00>;

	};
};
